## dts/bindings/behaviors/zmk,behavior-socd.yaml
```yaml
# Copyright (c) 2024 The ZMK Contributors
# SPDX-License-Identifier: MIT

description: |
  SOCD (Simultaneous Opposing Cardinal Directions) behavior.
  Wraps a pair of opposing keys and applies SOCD resolution when both
  are held simultaneously. Pass 0 to activate key0, or 1 to activate key1.

compatible: "zmk,behavior-socd"

include: one_param.yaml

properties:
  key0:
    type: int
    required: true
    description: Encoded ZMK keycode of the first key (e.g. A); must use a distinct output usage
  key1:
    type: int
    required: true
    description: Encoded ZMK keycode of the second key (e.g. D); must use a distinct output usage
  resolution:
    type: int
    required: false
    default: 0
    enum: [0, 1, 2, 3]
    description: |
      SOCD resolution strategy:
        0 = SOCD_LAST (last input priority with reactivation, "Snap Tap")
        1 = SOCD_NEUTRAL (both cancel, neither sent)
        2 = SOCD_KEY0_WINS (key0 always takes priority)
        3 = SOCD_KEY1_WINS (key1 always takes priority)
```
